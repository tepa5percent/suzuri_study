## config/west.yml
```yaml
manifest:
  remotes:
    - name: snize
      url-base: https://github.com/snize
  projects:
    - name: zmk-keyboard-suzuri
      remote: snize
      revision: main
      import: config/west.yml
  self:
    path: config
    
manifest:
  remotes:
    - name: mjmjm0101
      url-base: https://github.com/mjmjm0101

  projects:
    - name: zmk-input-processor-scroll-inertia
      remote: mjmjm0101
      revision: main
```
